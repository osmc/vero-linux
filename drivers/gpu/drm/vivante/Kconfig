## drivers/gpu/drm/vivante/Kconfig
```kconfig
config DRM_VIVANTE
        tristate "Vivante GCCore"
        depends on DRM
        help
          Choose this option if you have a Vivante graphics card.
          If M is selected, the module will be called vivante.
```

## drivers/mxc/gpu-viv/Kconfig
```kconfig
menu "Vivante GPU support"
	depends on SOC_IMX6Q

config MXC_GPU_VIV
	tristate "MXC Vivante GPU support v4 drivers (v5 drivers available if deselected)"
	---help---
         Say Y to get the GPU driver support.

config MXC_GPU_VIV_V5
	tristate "Vivante GPU support v5 drivers"
	depends on MXC_GPU_VIV=n
	---help---
         Say Y to get the GPU driver support.

endmenu
```
